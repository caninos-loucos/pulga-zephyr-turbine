## prj.conf
```kconfig
# Copyright (c) 2021 Nordic Semiconductor ASA
# SPDX-License-Identifier: Apache-2.0
#
# This file contains selected Kconfig options for the application.

# Activates the use of Zephyr's API for sensors
CONFIG_SENSOR=y
CONFIG_SYSTEM_WORKQUEUE_STACK_SIZE=2048

CONFIG_BT=y
CONFIG_BT_GATT_CLIENT=y
CONFIG_BT_BROADCASTER=y
CONFIG_BT_OBSERVER=y
CONFIG_LOG=y

CONFIG_BT_ATT_PREPARE_COUNT=1
CONFIG_BT_BAS=y
CONFIG_BT_HRS=y
CONFIG_BT_IAS=y
CONFIG_BT_CTS=y
CONFIG_BT_CTS_HELPER_API=y
CONFIG_BT_PERIPHERAL=y
CONFIG_BT_DIS=y

CONFIG_BT_CTLR_TX_PWR_PLUS_8=y  # Max +8 dBm for nRF52832/nRF52840

CONFIG_BT_L2CAP_TX_MTU=251
CONFIG_BT_BUF_ACL_RX_SIZE=260
CONFIG_BT_BUF_ACL_TX_SIZE=260
CONFIG_BT_CTLR_DATA_LENGTH_MAX=251

CONFIG_BT_RX_STACK_SIZE=4096

# Defines name that will be used to advertise device
CONFIG_BT_DEVICE_NAME="Pulga Turbine"
# Appearance = Generic Industrial Measurement Device
CONFIG_BT_DEVICE_APPEARANCE=5248
```

## src/main.c
```c
#include <zephyr/logging/log.h>

#include <zephyr/drivers/sensor.h>
#include <zephyr/drivers/i2c.h>

#include <zephyr/types.h>
#include <zephyr/sys/util.h>
#include <stddef.h>
#include <string.h>
#include <errno.h>

#include <assert.h>
#include <stdio.h>
#include <stdlib.h>

#include <zephyr/sys/printk.h>
#include <zephyr/sys/byteorder.h>
#include <zephyr/sys/reboot.h>
#include <zephyr/kernel.h>

#include <zephyr/bluetooth/bluetooth.h>
#include <zephyr/bluetooth/hci.h>
#include <zephyr/bluetooth/conn.h>
#include <zephyr/bluetooth/uuid.h>
#include <zephyr/bluetooth/gatt.h>
#include <zephyr/bluetooth/services/bas.h>

#include "bmi160.h"
//#include "bmx280_params.h"
//#include "bmx280.h"

// change log level in debug.conf
LOG_MODULE_REGISTER(main, CONFIG_APP_LOG_LEVEL);

/* Macros for frames to be read */

#define ACC_FRAMES 50 /* 50 Frames are available every 31,25ms @ 1600 Hz */
/* 50 frames containing a 1 byte header, 6 bytes of accelerometer,
 * This results in 7 bytes per frame*/
#define FIFO_SIZE 350

/* Variable declarations */
struct bmi160_dev bmi;

uint8_t fifo_buff[FIFO_SIZE];
struct bmi160_fifo_frame fifo_frame;
struct bmi160_sensor_data accel_data[ACC_FRAMES];

int8_t rslt;

typedef struct
{
    int16_t X_axis;
    int16_t Y_axis;
    int16_t Z_axis;
} leitura;

#define MAX_READINGS 1600

leitura readings_buffer[MAX_READINGS];
int write_index;

int8_t init_bmiSensor(void);
void direct_read(void);
int8_t acquire_ACC_Values(void);

static const struct device *dev;

union bmi160_bus {
	struct i2c_dt_spec i2c;
};

typedef bool (*bmi160_bus_ready_fn)(const struct device *dev);
typedef int (*bmi160_reg_read_fn)(const struct device *dev,
				  uint8_t reg_addr, void *data, uint8_t len);
typedef int (*bmi160_reg_write_fn)(const struct device *dev,
				   uint8_t reg_addr, void *data, uint8_t len);

struct bmi160_bus_io {
	bmi160_bus_ready_fn ready;
	bmi160_reg_read_fn read;
	bmi160_reg_write_fn write;
};

struct bmi160_cfg_i2c {
	union bmi160_bus bus;
	const struct bmi160_bus_io *bus_io;
};

int8_t user_i2c_read(uint8_t dev_addr, uint8_t reg_addr, uint8_t *data, uint16_t len)
{
    // LOG_DBG("i2c_read_regs(%d, %x, %x, ...)\n", dev, dev_addr, reg_addr);
    const struct bmi160_cfg_i2c *cfg = dev->config;

	return i2c_burst_read_dt(&cfg->bus.i2c, reg_addr, data, len);
}

int8_t user_i2c_write(uint8_t dev_addr, uint8_t reg_addr, uint8_t *data, uint16_t len)
{
    // LOG_DBG("i2c_write_regs(%d, %x, %x, ...)\n", dev, dev_addr, reg_addr);
    const struct bmi160_cfg_i2c *cfg = dev->config;

	return i2c_burst_write_dt(&cfg->bus.i2c, reg_addr, data, len);
}

void user_delay(uint32_t period)
{
    k_sleep(K_MSEC(period));
}

/* accel params and conversion constants */
// #define AC (float)2048.0 // for 16G
#define AC 8192.0F // for 4G
// #define AC (float)16384.0 // for 2G

#define STR_ANSWER_BUFFER_SIZE 4096

static uint8_t bt_connected, bt_advertising;
static uint8_t indicating, indicate_htm;
static struct bt_gatt_indicate_params ind_params;

#define READINGS_PER_INDICATE 40

uint16_t indicate_index;

uint32_t t1, t2, t3;

static void htmc_ccc_cfg_changed(const struct bt_gatt_attr *attr,
				 uint16_t value)
{
	indicate_htm = (value == BT_GATT_CCC_INDICATE) ? 1 : 0;
    LOG_DBG("ccc_indicate %s\n", indicate_htm == 0U ? "disabled" : "enabled");
}

static void indicate_cb(struct bt_conn *conn,
			struct bt_gatt_indicate_params *params, uint8_t err)
{
	if(err != 0U) LOG_DBG("Indication fail\n\r");
}

static void indicate_destroy(struct bt_gatt_indicate_params *params)
{
	//LOG_DBG("Indication complete\n");
	indicating = 0U;
    indicate_index++;
}

#define TURBINE_SVC_UUID                 BT_UUID_128_ENCODE(0x02b454b7, 0xc19f, 0x4d1c, 0xa2c0, 0xb7fc10f8a8a3)
#define TURBINE_CHR_IND_ACCEL_UUID      BT_UUID_128_ENCODE(0x682d75cf, 0x44fc, 0x4df4, 0xac81, 0x00f02aa9b98a)

static const struct bt_uuid_128 turb_svc = BT_UUID_INIT_128(TURBINE_SVC_UUID);
static const struct bt_uuid_128 turb_char_ind_accel_uuid = BT_UUID_INIT_128(TURBINE_CHR_IND_ACCEL_UUID);


/* BLE Service Declaration */
BT_GATT_SERVICE_DEFINE(hts_svc,
	BT_GATT_PRIMARY_SERVICE(&turb_svc),
	BT_GATT_CHARACTERISTIC(&turb_char_ind_accel_uuid.uuid, BT_GATT_CHRC_INDICATE,
			       BT_GATT_PERM_NONE, NULL, NULL, NULL),
    BT_GATT_CCC(htmc_ccc_cfg_changed,
		    BT_GATT_PERM_READ | BT_GATT_PERM_WRITE),
);

void hts_indicate(void)
{
    while(bt_connected && indicate_htm && indicate_index < MAX_READINGS/READINGS_PER_INDICATE){

        //LOG_DBG("Indication: %d\n", indicate_index);

        static uint8_t indicate_payload[1+6*READINGS_PER_INDICATE];

        indicate_payload[0] = indicate_index;
        
        memcpy(indicate_payload+1, &readings_buffer[indicate_index*READINGS_PER_INDICATE], 6*READINGS_PER_INDICATE ); // 2 bytes x 3 axis x readings

        ind_params.attr = &hts_svc.attrs[2];
        ind_params.func = indicate_cb;
        ind_params.destroy = indicate_destroy;
        ind_params.data = &indicate_payload;
        ind_params.len = sizeof(indicate_payload);

        if (bt_gatt_indicate(NULL, &ind_params) == 0) {
            indicating = 1U;
        }
        else LOG_DBG("Indication fail\n\r");

        while(indicating) {
            k_sleep(K_USEC(100));
        }
    }
    indicate_index = 0;
}

static void mtu_exchange_cb(struct bt_conn *conn, uint8_t err, struct bt_gatt_exchange_params *params)
{
	LOG_DBG("%s: MTU exchange %s (%u)\n", __func__, err == 0U ? "successful" : "failed", bt_gatt_get_mtu(conn));
}

static struct bt_gatt_exchange_params mtu_exchange_params = {
	.func = mtu_exchange_cb
};

static const struct bt_data ad[] = {
	BT_DATA_BYTES(BT_DATA_FLAGS, (BT_LE_AD_GENERAL | BT_LE_AD_NO_BREDR)),
	BT_DATA_BYTES(BT_DATA_UUID16_ALL,
		      BT_UUID_16_ENCODE(BT_UUID_HTS_VAL),
		      BT_UUID_16_ENCODE(BT_UUID_DIS_VAL)),
};

static const struct bt_data sd[] = {
	BT_DATA(BT_DATA_NAME_COMPLETE, CONFIG_BT_DEVICE_NAME, sizeof(CONFIG_BT_DEVICE_NAME) - 1),
};

static void connected(struct bt_conn *conn, uint8_t err)
{
	if (err) {
		LOG_ERR("Connection failed, err 0x%02x %s\n", err, bt_hci_err_to_str(err));
        bt_le_adv_stop();
	} else {
		LOG_DBG("Connected\n");

        bt_connected = 1;
        
        LOG_DBG("%s: Current MTU = %u\n", __func__, bt_gatt_get_mtu(conn));
        
        LOG_DBG("%s: Will try to exchange MTU...\n", __func__);
	    err = bt_gatt_exchange_mtu(conn, &mtu_exchange_params);
	    if (err) {
		    LOG_DBG("%s: MTU exchange failed (err %d)", __func__, err);
	    }
    }
    bt_advertising = 0;
}

static void disconnected(struct bt_conn *conn, uint8_t reason)
{
    bt_connected = 0;
	LOG_DBG("Disconnected, reason 0x%02x %s\n", reason, bt_hci_err_to_str(reason));
}

BT_CONN_CB_DEFINE(conn_callbacks) = {
	.connected = connected,
	.disconnected = disconnected,
};

static void bt_ready(void)
{
	int err;

	err = bt_le_adv_start(BT_LE_ADV_CONN_FAST_1, ad, ARRAY_SIZE(ad), sd, ARRAY_SIZE(sd));
	if (err) {
		LOG_ERR("Advertising failed to start (err %d)\n", err);
		return;
	}

    bt_advertising = 1;

	LOG_DBG("Advertising successfully started\n");
}

int main(void)
{
    k_sleep(K_MSEC(1000));
    
    rslt = init_bmiSensor();

    if (rslt != BMI160_OK)
        {
            LOG_DBG("Error init BMI160 - %d\n \r", rslt);
            goto out_error;
        }

    rslt = bt_enable(NULL);

    if (rslt)
        {
            LOG_DBG("Bluetooth init failed (err %d)\n \r", rslt);
            goto out_error;
        }

    LOG_DBG("Bluetooth initialized\n");

    bt_ready();
    
    k_sleep(K_MSEC(500));

    LOG_DBG("Reading BMI160 \n \r");

    while (1)
    {
        write_index = 0;
        rslt = bmi160_set_fifo_flush(&bmi);
        if (rslt != BMI160_OK)
        {
            LOG_DBG("Error flushing BMI160 FIFO - %d\n \r", rslt);
            goto out_error;
        }
        //LOG_DBG("flush ok");
        t1 = k_uptime_get();
        rslt = acquire_ACC_Values();
        t2 = k_uptime_get();
        //direct_read();
        hts_indicate();
        t3 = k_uptime_get();

        LOG_DBG("time acq: %d \n\r", t2 - t1);
        LOG_DBG("time indicate: %d \n\r", t3 - t2);

        if(!bt_connected && !bt_advertising)
        {
            bt_ready(); //re-enable advertising after disconnect
        }
    }
out_error:
    while (1)
    {
    LOG_DBG("System error, will reset pulga \n \r");
    k_sleep(K_MSEC(5000));
    sys_reboot(1);
    }
}

int8_t init_bmiSensor(void)
{
    LOG_DBG("Initializing BMI160");
    dev = DEVICE_DT_GET_ANY(bosch_bmi160);

    if (!dev)
    {
        LOG_ERR("bmi160 not declared at device tree");
        return -ENODEV;
    }
    else if (!device_is_ready(dev))
    {
        LOG_ERR("device \"%s\" is not ready", dev->name);
        return -EAGAIN;
    }


    k_sleep(K_MSEC(500));

    /* Initialize I2C as the host interface to the BMI160 */

    bmi.id = BMI160_I2C_ADDR;
    bmi.read = user_i2c_read;
    bmi.write = user_i2c_write;
    bmi.delay_ms = user_delay;
    bmi.intf = BMI160_I2C_INTF;

    rslt = bmi160_init_i2c(&bmi);
    if (rslt == BMI160_OK)
    {
        LOG_DBG("Success initializing BMI160 - Chip ID 0x%X\n \r", bmi.chip_id);
    }
    else if (rslt == BMI160_E_DEV_NOT_FOUND)
    {
        LOG_DBG("Error initializing BMI160: device not found\n \r");
        return rslt;
    }
    else
    {
        LOG_DBG("Error initializing BMI160 - %d\n \r", rslt);
        return rslt;
    }

    /* Select the Output data rate, range of accelerometer sensor */
    bmi.accel_cfg.odr = BMI160_ACCEL_ODR_1600HZ;
    bmi.accel_cfg.range = BMI160_ACCEL_RANGE_4G;
    // bmi.accel_cfg.range = BMI160_ACCEL_RANGE_2G;

    /* Normal power mode for accelerometer */
    bmi.accel_cfg.power = BMI160_ACCEL_NORMAL_MODE;

    /* Suspend power mode for Gyroscope */
    bmi.gyro_cfg.power = BMI160_GYRO_SUSPEND_MODE;

    /* Set the sensor configuration */
    rslt = bmi160_set_sens_conf(&bmi);
    if (rslt != BMI160_OK)
    {
        LOG_DBG("Error configuring BMI160 - %d\n \r", rslt);
        return rslt;
    }
    
    LOG_DBG("config \n \r");
    
    /* Link the FIFO memory location */
    fifo_frame.data = fifo_buff;
    fifo_frame.length = FIFO_SIZE;
    bmi.fifo = &fifo_frame;

    /* Clear all existing FIFO configurations */
    rslt = bmi160_set_fifo_config(BMI160_FIFO_CONFIG_1_MASK, BMI160_DISABLE, &bmi);
    if (rslt != BMI160_OK)
    {
        LOG_DBG("Error clearing fifo - %d\n \r", rslt);
        return rslt;
    }
    LOG_DBG("clear \n \r");
    uint8_t fifo_config = BMI160_FIFO_HEADER | BMI160_FIFO_ACCEL;
    rslt = bmi160_set_fifo_config(fifo_config, BMI160_ENABLE, &bmi);
    if (rslt != BMI160_OK)
    {
        LOG_DBG("Error enabling fifo - %d\n \r", rslt);
        return rslt;
    }
    LOG_DBG("enable \n \r");

    return BMI160_OK;
}

int8_t acquire_ACC_Values(void)
{
    while(write_index < MAX_READINGS){
        /* It is VERY important to reload the length of the FIFO memory as after the
         * call to bmi160_get_fifo_data(), the bmi.fifo->length contains the
         * number of bytes read from the FIFO */
        bmi.fifo->length = FIFO_SIZE;
        
        rslt = bmi160_get_fifo_data(&bmi);
        if (rslt != BMI160_OK)
        {
            LOG_DBG("Error getting fifo data - %d\n \r", rslt);
            return rslt;
        }

        uint8_t acc_inst = ACC_FRAMES;
        rslt = bmi160_extract_accel(accel_data, &acc_inst, &bmi);
        if (rslt != BMI160_OK)
        {
            LOG_DBG("Error extracting accel data - %d\n \r", rslt);
            return rslt;
        }
        
        
        for (int j = 0; j < acc_inst && write_index < MAX_READINGS; j++)
        {
            memcpy(&readings_buffer[write_index], accel_data, 6); // 2 bytes x 3 axis
            write_index++; // increment write index
        }
    }

    return BMI160_OK;
}

/*void direct_read(void)
{
    for (int i = 0; i < MAX_READINGS; i++)
    {
        LOG_DBG("%2.6f %2.6f %2.6f \n\r", (readings_buffer[i].X_axis / AC)
                                     , (readings_buffer[i].Y_axis / AC)
                                     , (readings_buffer[i].Z_axis / AC));
    }
}*/
```
