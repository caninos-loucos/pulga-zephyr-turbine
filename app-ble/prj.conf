## CMakeLists.txt
```
#-------------------------------------------------------------------------------
# Zephyr Example Application
#
# Copyright (c) 2021 Nordic Semiconductor ASA
# SPDX-License-Identifier: Apache-2.0

cmake_minimum_required(VERSION 3.13.1)

# Uncomment to activate GPS shield, when Pulga-GPS module is attached to the stack
# list(APPEND SHIELD pulga_gps)

# Uncomment to activate LoRa shield, when Pulga-LoRa module is attached to the stack
# list(APPEND SHIELD pulga-lora)

# Uncomment to activate SCD30 shield, a CO2 concentration sensor
# list(APPEND SHIELD scd30)

find_package(Zephyr REQUIRED HINTS $ENV{ZEPHYR_BASE})

project(app LANGUAGES C)

target_include_directories(app PRIVATE ${CMAKE_CURRENT_SOURCE_DIR}/src)

target_sources(app PRIVATE 
                    src/main.c)
```

## prj.conf
```kconfig
# Copyright (c) 2021 Nordic Semiconductor ASA
# SPDX-License-Identifier: Apache-2.0
#
# This file contains selected Kconfig options for the application.

# Activates the use of Zephyr's API for sensors
CONFIG_SYSTEM_WORKQUEUE_STACK_SIZE=2048

CONFIG_BT=y
CONFIG_BT_BROADCASTER=y
CONFIG_BT_OBSERVER=y
CONFIG_LOG=y

CONFIG_BT_ATT_PREPARE_COUNT=1
CONFIG_BT_BAS=y
CONFIG_BT_HRS=y
CONFIG_BT_IAS=y
CONFIG_BT_CTS=y
CONFIG_BT_CTS_HELPER_API=y
CONFIG_BT_PERIPHERAL=y
CONFIG_BT_DIS=y

CONFIG_BT_CTLR_TX_PWR_PLUS_8=y  # Max +8 dBm for nRF52832/nRF52840

CONFIG_BT_RX_STACK_SIZE=4096

# Defines name that will be used to advertise device
CONFIG_BT_DEVICE_NAME="Pulga Turbine"
# Appearance = Generic Sensor
CONFIG_BT_DEVICE_APPEARANCE=768

CONFIG_APP_LOG_LEVEL_DBG=y
CONFIG_DEBUG_OPTIMIZATIONS=y
CONFIG_LOG_PROCESS_THREAD_SLEEP_MS=1
CONFIG_LOG_PROCESS_THREAD_STACK_SIZE=1024
CONFIG_LOG_BUFFER_SIZE=8192
CONFIG_DEBUG_THREAD_INFO=y
```

## src/main.c
```c
#include <zephyr/logging/log.h>


#include <zephyr/types.h>
#include <stddef.h>
#include <string.h>
#include <errno.h>
#include <stdio.h>
#include <zephyr/sys/printk.h>
#include <zephyr/sys/byteorder.h>
#include <zephyr/kernel.h>

#include <zephyr/bluetooth/bluetooth.h>
#include <zephyr/bluetooth/hci.h>
#include <zephyr/bluetooth/conn.h>
#include <zephyr/bluetooth/uuid.h>
#include <zephyr/bluetooth/gatt.h>
//#include <zephyr/bluetooth/services/bas.h>


// change log level in debug.conf
LOG_MODULE_REGISTER(main, CONFIG_APP_LOG_LEVEL);

static const struct bt_data ad[] = {
	BT_DATA_BYTES(BT_DATA_FLAGS, (BT_LE_AD_GENERAL | BT_LE_AD_NO_BREDR)),
	BT_DATA_BYTES(BT_DATA_UUID16_ALL)
};

static const struct bt_data sd[] = {
	BT_DATA(BT_DATA_NAME_COMPLETE, CONFIG_BT_DEVICE_NAME, sizeof(CONFIG_BT_DEVICE_NAME) - 1),
};

static void connected(struct bt_conn *conn, uint8_t err)
{
	if (err) {
		printf("Connection failed, err 0x%02x %s\n", err, bt_hci_err_to_str(err));
	} else {
		printf("Connected\n");
	}
}

static void disconnected(struct bt_conn *conn, uint8_t reason)
{
	printf("Disconnected, reason 0x%02x %s\n", reason, bt_hci_err_to_str(reason));
}

BT_CONN_CB_DEFINE(conn_callbacks) = {
	.connected = connected,
	.disconnected = disconnected,
};

static void bt_ready(void)
{
	int err;

	printf("Bluetooth initialized\n");

	err = bt_le_adv_start(BT_LE_ADV_CONN_FAST_1, ad, ARRAY_SIZE(ad), sd, ARRAY_SIZE(sd));
	if (err) {
		printf("Advertising failed to start (err %d)\n", err);
		return;
	}

	printf("Advertising successfully started\n");
}

int main(void)
{
    k_busy_wait(1e6);
    int err = bt_enable(NULL);
    if (err) {
		while(1){
            k_busy_wait(1000);
            printf("Bluetooth init failed (err %d)\n", err);
        }
	}

    bt_ready();

    while(1){
        k_busy_wait(1e6);
       printf("main() ready\n\r");

    }


}
```
